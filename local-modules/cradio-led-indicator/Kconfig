## local-modules/cradio-led-indicator/Kconfig
```kconfig
config INDICATOR_LED_WIDGET
    bool "Enable RGB LED widget for showing battery and output status"

config CRADIO_STUCK_KEY_SLEEP
    bool "Protect sleep from stuck local keys"
    depends on ZMK_PM_SOFT_OFF
    help
      Enter ZMK soft-off when at least one local key remains held without
      any local pressed-key set changes for the configured timeout.

config CRADIO_SPLIT_IDLE_SCAN_GUARD
    bool "Stop split scanning after an idle peripheral disconnect"
    depends on ZMK_SPLIT && ZMK_SPLIT_ROLE_CENTRAL
    help
      Stop the active split central transport when the keyboard is idle and
      every split peripheral is disconnected.

config CRADIO_STUCK_KEY_SLEEP_TIMEOUT_MS
    int "Stuck-key protected sleep timeout in milliseconds"
    default 600000
    range 1 2147483647
    depends on CRADIO_STUCK_KEY_SLEEP

config CRADIO_STUCK_KEY_WAKEUP_INIT_PRIORITY
    int
    default 99
    depends on CRADIO_STUCK_KEY_SLEEP

if INDICATOR_LED_WIDGET

config LED
    default y

config INDICATOR_LED_SHOW_LAYER_CHANGE
    bool "Indicate highest active layer on each layer change with a sequence of blinks"
        default y

config INDICATOR_LED_LAYER_PERSISTENCE_THRESHOLD
    int "At which layer number (starting from 0) should the LED stay lit after its blink sequence, to indicate a non-default layer is still active."
        default 200

config INDICATOR_LED_SHOW_BATTERY_ON_BOOT
    bool "Indicate battery level once on startup, one fast blink per full 10 percent"
        default y

config INDICATOR_LED_SHOW_BLE
    bool "Indicate BLE status on startup with a sequence of blinks"
        default y

config INDICATOR_LED_SHOW_PERIPHERAL_BLE
    bool "Indicate on the peripheral half of a split what its connection status is, with a sequence of blinks."
        default y
    depends on INDICATOR_LED_SHOW_BLE
        help
            Requires INDICATOR_LED_SHOW_BLE to be enabled.

config INDICATOR_LED_INTERVAL_MS
    int "Minimum wait duration between blink sequences in ms"
    default 500

endif
```

## local-modules/cradio-led-indicator/dts/bindings/cradio,stuck-key-wakeup.yaml
```yaml
# Copyright (c) 2026
# SPDX-License-Identifier: MIT

description: Wake source that ignores keys held when protected sleep starts

compatible: "cradio,stuck-key-wakeup"

include: base.yaml

properties:
  kscan:
    type: phandle
    required: true
    description: Direct GPIO kscan whose input-gpios should be used as wake keys.
```
